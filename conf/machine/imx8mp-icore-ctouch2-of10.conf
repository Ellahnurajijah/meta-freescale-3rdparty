## conf/machine/imx8mp-icore-ctouch2-of10.conf
```bitbake
#@TYPE: Machine
#@NAME: Engicam based IMX8MPLUS ICORE
#@SOC: i.MX8 MP
#@DESCRIPTION: Machine configuration for Engicam Based imx8MPlus SOM.

MACHINEOVERRIDES =. "mx8mp:imx-boot-container:"

IMX_DEFAULT_BSP ?= "mainline"

require conf/machine/include/imx-base.inc
require conf/machine/include/arm/armv8a/tune-cortexa53.inc

# Kernel configuration
PREFERRED_PROVIDER_virtual/kernel ??= "linux-imx8mp-icore"
KERNEL_DEVICETREE = "freescale/imx8mp-icore-mx8mp-ctouch2-of10.dtb \
"
KERNEL_DEVICETREE_BASENAME = "imx8mp-icore-mx8mp-ctouch2-of10"
KERNEL_IMAGETYPE = "Image"
RRECOMMENDS:${KERNEL_PACKAGE_NAME}-base = ""

KERNEL_VERSION_SANITY_SKIP="1"

# U-Boot configuration
PREFERRED_PROVIDER_u-boot ??= "u-boot-imx8mp-icore"
PREFERRED_PROVIDER_virtual/bootloader ??= "u-boot-imx8mp-icore"
UBOOT_EXTLINUX = "1"

UBOOT_EXTLINUX = "1"
UBOOT_EXTLINUX_LABELS  = "default"
UBOOT_EXTLINUX_DEFAULT_LABEL = "MX8MPLUS"

UBOOT_EXTLINUX_MENU_DESCRIPTION:default = "i.MX8MPLUS"
UBOOT_EXTLINUX_FDT:default    = "../imx8mp-icore-mx8mp-ctouch2-of10.dtb"
UBOOT_EXTLINUX_KERNEL_IMAGE ?= "../Image"
UBOOT_EXTLINUX_CONSOLE:default = "console=${console}"
UBOOT_EXTLINUX_ROOT:default  ??= "root=/dev/mmcblk1p2"

PREFERRED_PROVIDER_imx-atf ??= "imx-atf"

SPL_BINARY = "spl/u-boot-spl.bin"
UBOOT_SUFFIX = "bin"

UBOOT_CONFIG ??= "sd"
UBOOT_CONFIG[sd]   = "imx8mp-icore-mx8mp-edimm2.2_defconfig,sdcard"


ATF_PLATFORM = "imx8mp"
ATF_LOAD_ADDR = "0x970000"
TEE_LOAD_ADDR = "0x56000000"

DDR_FIRMWARE_NAME = "\
    lpddr4_pmu_train_1d_imem_202006.bin \
    lpddr4_pmu_train_1d_dmem_202006.bin \
    lpddr4_pmu_train_2d_imem_202006.bin \
    lpddr4_pmu_train_2d_dmem_202006.bin \
"
ACCEPT_FSL_EULA = "1"

IMX_BOOT_SEEK = "32"
# Add extlinux.conf to the lis of files, which are deployed onto the
# boot partition
IMAGE_BOOT_FILES:append = " extlinux.conf;extlinux/extlinux.conf \
                            flash.bin-${MACHINE}-sd;u-boot.${MACHINE}_sd \"

IMAGE_INSTALL:append = "kernel-modules"

IMAGE_ROOTFS_EXTRA_SPACE = "2000000"

OPTEE_BIN_EXT = "8mp"

SERIAL_CONSOLES = "115200;ttymxc1"

MACHINE_FEATURES += " pci wifi bluetooth"
```
